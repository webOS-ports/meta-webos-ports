## conf/distro/include/webos-ports.inc
```bitbake
# Settings specific for webos-ports

DEPLOY_DIR_IMAGE = "${DEPLOY_DIR}/images/${MACHINE}"

LICENSE_CREATE_PACKAGE = "1"

require conf/distro/include/defaulttunes.inc

#############################################################################
# Ensure MACHINE_CLASS is in OVERRIDES and is not empty as :: in OVERRIDES
# breaks order of OVERRIDES ie in FILESPATH
#############################################################################
MACHINE_CLASS ?= "${MACHINE}"
MACHINEOVERRIDES .= ":${MACHINE_CLASS}"
MACHINEOVERRIDES[vardepsexclude] = "MACHINE MACHINE_CLASS"
OVERRIDES[vardepsexclude] = "MACHINE MACHINE_CLASS"

# switch from upstart to systemd
WEBOS_DISTRO_FEATURES_INIT = "systemd"
WEBOS_DISTRO_FEATURES_INIT_CONSIDERED = "sysvinit"
VIRTUAL-RUNTIME_initscripts = ""
VIRTUAL-RUNTIME_init_manager = "systemd systemd-compat-units systemd-machine-units"
BAD_RECOMMENDATIONS = "update-rc.d"

# Enable adb support
DISTRO_FEATURES += "adb"

# For proper support of wayland through the whole stack we need to set it as distro
# feature (e.g. mesa requiers it to be set to compile the egl platform module)
DISTRO_FEATURES += "wayland"

VIRTUAL-RUNTIME_webappmanager = "webapp-launcher"
VIRTUAL-RUNTIME_webos-compositor = "luna-next"
VIRTUAL-RUNTIME_webos-ime = "webos-keyboard"

inherit android_image_types

OPKGLIBDIR_forcevariable := "${localstatedir}/lib"
```

## conf/distro/include/webos-preferred-providers.inc
```bitbake
# Copyright (c) 2012-2014 LG Electronics, Inc.

# Place distro-wide PREFERRED_PROVIDER settings here; place MACHINE-specific
# settings in <MACHINE>.conf .

# Prefer libjpeg-turbo from meta-oe as it provides SIMD optimizations
PREFERRED_PROVIDER_jpeg = "libjpeg-turbo"
PREFERRED_PROVIDER_jpeg-native = "libjpeg-turbo-native"

# android-headers or phablet-headers
PREFERRED_PROVIDER_virtual/android-headers = "android-headers"

# Just for documentation; these values are the defaults set in the recipes that
# use them.
VIRTUAL-RUNTIME_cpushareholder = "cpushareholder-stub"
VIRTUAL-RUNTIME_rdx-utils = "rdx-utils-stub"

# Don't install big /boot/vmlinux* file by default in qemux86 images (included in oprofile's RRECOMMENDS)
# Use --no-vmlinux option to opcontrol or install it manually if you need to see samples from kernel
BAD_RECOMMENDATIONS_append_qemux86 = " kernel-vmlinux"
```

## conf/distro/include/webos-preferred-versions.inc
```bitbake
# Copyright (c) 2012-2014 LG Electronics, Inc.

#
# NOTE: Keep the lists in alphabetical order
#

# Newer upstream meta-oe already has yajl 2.0.3, and we should upgrade to it soon,
# because it's already compatible with our libpbnjson.
PREFERRED_VERSION_yajl ?= "1.0.12"

QT5_VERSION = "5.4.0+git%"
require conf/distro/include/qt5-versions.inc

PREFERRED_VERSION_ofono = "1.14+gitr%"
```

## conf/distro/include/webos-recipe-blacklist.inc
```bitbake
# Copyright (c) 2013 LG Electronics

# A blacklisted recipe is ignored by bitbake. The reason it is useful to be able
# to have bitbake ignore a recipe is because, although PREFERRED_PROVIDER can be
# used to select which recipe is used to fulfill a build-time dependency, bitbake
# does not have a PREFERRED_RPROVIDER to allow specification of which package
# should be used to satisfy a run-time dependency. When two recipes both provide
# common packages, but one recipe provides additional packages that the other
# doesn't, then the only way to guarantee that the first recipe will never be
# used is to blacklist it.

INHERIT += "blacklist"

include conf/distro/include/webos-recipe-blacklist-world.inc

PNBLACKLIST[gstreamer1.0] = "We still have to use gstreamer 0.10"
PNBLACKLIST[gstreamer1.0-plugins-bad] = "We still have to use gstreamer 0.10"
PNBLACKLIST[gstreamer1.0-plugins-base] = "We still have to use gstreamer 0.10"
PNBLACKLIST[gstreamer1.0-plugins-good] = "We still have to use gstreamer 0.10"
PNBLACKLIST[gstreamer1.0-plugins-ugly] = "We still have to use gstreamer 0.10"
```

## conf/layer.conf
```bitbake
# Copyright (c) 2012-2013 LG Electronics, Inc.

BBPATH ?= ""
# We have a conf and classes directory, add to BBPATH
BBPATH .= ":${LAYERDIR}"
# We have recipe directories, add to BBFILES
BBFILES += "${LAYERDIR}/recipes-*/*/*.bb ${LAYERDIR}/recipes-*/*/*.bbappend"

BBFILE_COLLECTIONS += "meta-webos-ports"
BBFILE_PATTERN_meta-webos-ports := "^${LAYERDIR}/"
BBFILE_PRIORITY_meta-webos-ports = "15"

# Prepend scripts to WEBOS_EXTRA_PATH
WEBOS_EXTRA_PATH .= "${@'${BBFILE_PATTERN_meta-webos-ports}'[1:] + 'scripts:'}"

# Set path to qemu image tests included in this layer
QEMUIMAGETESTS := "${COREBASE}/scripts/qemuimage-tests"

SIGGEN_EXCLUDERECIPES_ABISAFE += " \
  upstart-getty \
  luna-prefs-data \
"
```

## meta-luneos-backports-2.8/conf/layer.conf
```bitbake
BBPATH ?= ""
# We have a conf and classes directory, add to BBPATH
BBPATH .= ":${LAYERDIR}"
# We have recipe directories, add to BBFILES
BBFILES += "${LAYERDIR}/recipes-*/*/*.bb ${LAYERDIR}/recipes-*/*/*.bbappend"

BBFILE_COLLECTIONS += "meta-luneos-backports-2.8"
BBFILE_PATTERN_meta-luneos-backports-2.8 := "^${LAYERDIR}/"
BBFILE_PRIORITY_meta-luneos-backports-2.8 = "10"

LAYERSERIES_COMPAT_meta-luneos-backports-2.8 = "warrior"
```

## meta-luneos-backports-3.1/conf/layer.conf
```bitbake
BBPATH ?= ""
# We have a conf and classes directory, add to BBPATH
BBPATH .= ":${LAYERDIR}"
# We have recipe directories, add to BBFILES
BBFILES += "${LAYERDIR}/recipes-*/*/*.bb ${LAYERDIR}/recipes-*/*/*.bbappend"

BBFILE_COLLECTIONS += "meta-luneos-backports-3.1"
BBFILE_PATTERN_meta-luneos-backports-3.1 := "^${LAYERDIR}/"
BBFILE_PRIORITY_meta-luneos-backports-3.1 = "10"

LAYERSERIES_COMPAT_meta-luneos-backports-3.1 = "zeus"
```

## meta-luneos-backports-4.3/conf/layer.conf
```bitbake
# Copyright (c) 2023 Herman van Hazendonk <github.com@herrie.org>

# We have conf and classes directories => add to BBPATH
BBPATH .= ":${LAYERDIR}"

# We have recipes-* directories => add to BBFILES
BBFILES += "${LAYERDIR}/recipes-*/*/*.bb \
            ${LAYERDIR}/recipes-*/*/*.bbappend"

BBFILE_COLLECTIONS += "meta-luneos-backports-4.3"
BBFILE_PATTERN_meta-luneos-backports-4.3 := "^${LAYERDIR}/"
BBFILE_PRIORITY_meta-luneos-backports-4.3 = "32"

LAYERSERIES_COMPAT_meta-luneos-backports-4.3 = "kirkstone"

LAYERDEPENDS_meta-luneos-backports-4.3 = " \
    core \
    openembedded-layer \
"
```

## meta-luneos-backports-5.1/conf/layer.conf
```bitbake
# Copyright (c) 2024 Christophe Chapuis <chris.chapuis@gmail.com>

# We have conf and classes directories => add to BBPATH
BBPATH .= ":${LAYERDIR}"

# We have recipes-* directories => add to BBFILES
BBFILES += "${LAYERDIR}/recipes-*/*/*.bb \
            ${LAYERDIR}/recipes-*/*/*.bbappend"

BBFILE_COLLECTIONS += "meta-luneos-backports-5.1"
BBFILE_PATTERN_meta-luneos-backports-5.1 := "^${LAYERDIR}/"
BBFILE_PRIORITY_meta-luneos-backports-5.1 = "32"

LAYERSERIES_COMPAT_meta-luneos-backports-5.1 = "scarthgap"

LAYERDEPENDS_meta-luneos-backports-5.1 = " \
    core \
    openembedded-layer \
"
```

## meta-luneos/conf/distro/include/defaulttunes.inc
```bitbake
# This is DISTRO decision to use more optimized feeds for supported MACHINEs
# than default armv7a-neon
# it's always compromise between higher optimalization and sharing feed
# (building once for multiple MACHINES)
# For more information and benchmark read this thread:
# http://mailman.openwebosproject.org/pipermail/openwebos-general/2012-November/000156.html
# http://mailman.openwebosproject.org/pipermail/openwebos-general/2012-December/000159.html
# http://mailman.openwebosproject.org/pipermail/openwebos-general/2013-January/000177.html
# https://docs.google.com/spreadsheet/ccc?key=0Avaa_xKWksbWdDBoWjU2LU1FTVFiZDJuZTlGNkgzcFE

# Always check if recipes-core/meta/distro-feed-configs.bbappend includes all
# feeds for given DEFAULTTUNE when changing this file

# If you're changing this file then:
# build image and reflash or at least rebuild opkg-config-base distro-feed-configs
# and opkg -force-reinstall opkg-config-base distro-feed-configs
# on target to get new /etc/opkg/arch.conf

# DEFAULTTUNE:tuna = "cortexa8t-neon"
# DEFAULTTUNE:grouper = "cortexa8t-neon"

# or if you don't care about sharing binary feed between armv7a machines, 
# add this to local.conf after that require line
# DEFAULTTUNE:tuna = "cortexa9t-neon"

# A500 is using cortexa9, because Tegra2 does not support neon, so we cannot share
# feed with it unless we disable neon also for tuna:
# DEFAULTTUNE_a500 = "cortexa9"
# DEFAULTTUNE:tuna = "cortexa9"
# but be aware that grouper doesn't have cortexa9 available and a500 does not have cortexa8
# if you want to use cortexa8 for all add cortexa8 settings to a500 (see tuna.conf).

ARM_INSTRUCTION_SET = "thumb"
DEFAULTTUNE:tenderloin-halium = "cortexa8thf-neon"
DEFAULTTUNE:hammerhead-halium = "cortexa8thf-neon"
DEFAULTTUNE:tenderloin = "cortexa8thf-neon"
DEFAULTTUNE:hammerhead = "cortexa8thf-neon"
DEFAULTTUNE:mako = "cortexa8thf-neon"
DEFAULTTUNE:athene = "cortexa8thf-neon"
DEFAULTTUNE:onyx = "cortexa8thf-neon"

# in meta-smartphone/meta-android/conf/machine/include/meta-android-halium.inc
# we do:
# TUNE_PKGARCH:append = "-halium"
# PACKAGE_EXTRA_ARCHS:append = " ${TUNE_PKGARCH}"
# but when building something with thumb disabled (e.g. webruntime-108), we need to search nspr in
# cortexa8t2hf-neon-halium, not cortexa8hf-neon-halium used by webruntime, add it explicitly here, but it's far from ideal
PACKAGE_EXTRA_ARCHS_HALIUM = "${@oe.utils.conditional('ARM_INSTRUCTION_SET', 'thumb', 'cortexa8hf-neon-halium', 'cortexa8t2hf-neon-halium', d) }"
PACKAGE_EXTRA_ARCHS:append:tenderloin-halium = " ${PACKAGE_EXTRA_ARCHS_HALIUM}"
PACKAGE_EXTRA_ARCHS:append:hammerhead-halium = " ${PACKAGE_EXTRA_ARCHS_HALIUM}"

# http://lists.openembedded.org/pipermail/openembedded-core/2019-April/281328.html
# make sure that raspberrypi[34]-64 originally with
# DEFAULTTUNE="cortexa53"/DEFAULTTUNE="cortexa72"
# uses different TUNE_PKGARCH
# than e.g. tissot with DEFAULTTUNE="aarch64"
# it's not sure if crypto will actually work with cortexa53/BCM2837 used
# in raspberrypi3 B, see last comments in:
# https://www.raspberrypi.org/forums/viewtopic.php?t=207888
# about the license for Cryptography Extension, but hopefully the software
# built with crypto enabled will correctly check ID_AA64ISAR0_EL1 before actually using it.
DEFAULTTUNE:raspberrypi3-64 = "armv8a-crc-crypto"
TUNE_PKGARCH_64:raspberrypi3-64 = "aarch64-rpi"
PACKAGE_EXTRA_ARCHS:append:raspberrypi3-64 = " aarch64-rpi"
DEFAULTTUNE:raspberrypi4-64 = "armv8a-crc-crypto"
TUNE_PKGARCH_64:raspberrypi4-64 = "aarch64-rpi"
PACKAGE_EXTRA_ARCHS:append:raspberrypi4-64 = " aarch64-rpi"

# Undo the switch to x86-64-v3 from:
# https://git.openembedded.org/openembedded-core/commit/?id=6f2af1e5d1537b4d31e14946292bf58f0fd76fc9
# https://git.openembedded.org/openembedded-core/commit/?id=ac041f90e71dba83b7144c91f929de88aaeae519
# because we use VirtualBox and it doesn't support fma, f16c as shown with various Qt binaries:
# root@qemux86-64:~# mediaindexer
# Incompatible processor. This Qt build requires the following features: fma f16c

# There is 7 years old enhancement ticket for Virtualbox without any progress:
# https://www.virtualbox.org/ticket/15471

# Don't switch all the way back to core2-64, corei7-64 should be fine nowadays.
# core2-64 (Intel Core2 CPU with 64-bit extensions, MMX, SSE, SSE2, SSE3 and SSSE3 instruction set support. Intel Core 2 CPU family, including Conroe, Merom and beyond, as well as the first Atom CPUs, Diamondville, and beyond)
# corei7-64 (Intel Nehalem CPU with 64-bit extensions, MMX, SSE, SSE2, SSE3, SSSE3, SSE4.1, SSE4.2 and POPCNT instruction set support. This tune is recommended for Intel Nehalem and Silvermont (e.g. Bay Trail) CPUs (and beyond)).
# x86-64-v3 (CPUs with AVX, AVX2, BMI1, BMI2, F16C, FMA, LZCNT, MOVBE, XSAVE. (but not AVX512). See https://www.phoronix.com/news/GCC-11-x86-64-Feature-Levels for details.)
DEFAULTTUNE:qemux86-64 = "corei7-64"
```

## meta-luneos/conf/distro/include/luneos-recipe-blacklist.inc
```bitbake
# Copyright (c) 2013 LG Electronics

# A blacklisted recipe is ignored by bitbake. The reason it is useful to be able
# to have bitbake ignore a recipe is because, although PREFERRED_PROVIDER can be
# used to select which recipe is used to fulfill a build-time dependency, bitbake
# does not have a PREFERRED_RPROVIDER to allow specification of which package
# should be used to satisfy a run-time dependency. When two recipes both provide
# common packages, but one recipe provides additional packages that the other
# doesn't, then the only way to guarantee that the first recipe will never be
# used is to blacklist it.

SKIP_RECIPE[vboxguestdrivers] = "vboxguest is also in the kernel and we don't really need vboxsf"
SKIP_RECIPE[qtwebengine] = "qtwebengine is now replaced by WebOS OSE webruntime"
SKIP_RECIPE[qtwebview] = "depends on blacklisted qtwebengine"
```
